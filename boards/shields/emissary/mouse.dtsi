#define ZMK_POINTING_DEFAULT_MOVE_VAL 1500  // default: 600
#define ZMK_POINTING_DEFAULT_SCRL_VAL 20    // default: 10
#include <dt-bindings/zmk/pointing.h>

&mmv {
  acceleration-exponent = <1>;      // 1
  time-to-max-speed-ms = <100>;    // 40
  delay-ms = <0>;                   // 0
};

&msc {
  acceleration-exponent = <0>;      // 0
  time-to-max-speed-ms = <0>;    // 40
  delay-ms = <0>;                   // 10
};

#define U_MOUSE_MOVE_MAX 2500       // 600
#define U_MOUSE_SCROLL_MAX 15      // 10
